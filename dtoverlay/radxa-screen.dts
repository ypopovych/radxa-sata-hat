// Overlay for Radxa board SSD1306 128x32 OLED display
/dts-v1/;
/plugin/;

/ {
    compatible = "brcm,bcm2835";

    fragment@0 {
        target = <&i2c1>;
        
        __overlay__ {
            status = "okay";
                
            #address-cells = <1>;
            #size-cells = <0>;

	        ssd1306: oled@3c {
		        compatible = "solomon,ssd1306fb-i2c";
		        reg = <0x3c>;
		        reset-gpios = <&gpio 23 1>;
		        solomon,width = <128>;
		        solomon,height = <32>;
		        solomon,page-offset = <0>;
		        solomon,com-invdir;
		        solomon,com-seq;
	        };
	    };
    };
};